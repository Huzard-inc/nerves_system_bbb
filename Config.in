## Config.in
```kconfig
# Add project-specific packages for Buildroot here

source "$NERVES_DEFCONFIG_DIR/package/extra-dts/Config.in"
source "$NERVES_DEFCONFIG_DIR/package/rpmsg-pru/Config.in"
```

## package/rpmsg-pru/Config.in
```kconfig
menuconfig BR2_PACKAGE_RPMSG_PRU
	bool "rpmsg-pru"
	select BR2_LINUX_KERNEL
	help
	  RPMsg drivers for the BeagleBone PRUs

	  https://github.com/beagleboard/linux
```
